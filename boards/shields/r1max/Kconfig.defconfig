## boards/shields/r1max/Kconfig.defconfig
```kconfig
if SHIELD_R1MAX_LEFT

# Name must be less than 16 characters long!
config ZMK_KEYBOARD_NAME
    default "r1max"

config ZMK_SPLIT_ROLE_CENTRAL
    default y

endif

if SHIELD_R1MAX_LEFT || SHIELD_R1MAX_RIGHT

config ZMK_SPLIT
    default y

endif
```

## boards/shields/r1max/Kconfig.shield
```kconfig
config SHIELD_R1MAX_LEFT
    def_bool $(shields_list_contains,r1max_left)

# No whitespace after the comma or in your part name!
config SHIELD_R1MAX_RIGHT
    def_bool $(shields_list_contains,r1max_right)
```
